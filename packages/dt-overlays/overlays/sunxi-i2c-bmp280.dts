/dts-v1/;
/plugin/;

/ {
        compatible = "allwinner,sun8i-h3";

        fragment@0 {
              target = <&i2c0>;
              __overlay__ {
                    #address-cells = <1>;
                    #size-cells = <0>;
                    status = "okay";

                    bmp280@76 {
                            compatible = "bosch,bmp280";
                            reg = <0x76>;
                            status = "okay";
                    };
              };
        };
};
