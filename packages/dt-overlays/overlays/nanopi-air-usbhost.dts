/dts-v1/;
/plugin/;

/ {
    compatible = "allwinner,sun8i-h3";

    fragment@0 {
        target = <&usb_otg>;
        __overlay__ {
            dr_mode = "host";
            status = "okay";
        };
    };

};
