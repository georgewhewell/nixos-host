/dts-v1/;
/plugin/;

/ {
	compatible = "allwinner,sun50i-h5";

	fragment@0 {
		target = <&uart1>;
		 __overlay__ {
        pinctrl-names = "default";
        pinctrl-0 = <&uart1_pins>, <&uart1_rts_cts_pins>;
        uart-has-rtscts;
        status = "okay";
		};
	};
};
