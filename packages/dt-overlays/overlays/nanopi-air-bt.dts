/dts-v1/;
/plugin/;

/ {
  compatible = "allwinner,sun8i-h3";

  fragment@0 {
    target = <&uart3>;

    __overlay__ {
      pinctrl-names = "default";
      pinctrl-0 = <&uart3_pins>, <&uart3_rts_cts_pins>;
      uart-has-rtscts;

      status = "okay";

    };
  };
};
